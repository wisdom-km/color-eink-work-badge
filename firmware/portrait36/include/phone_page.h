// SPDX-License-Identifier: MIT
// Generated by tools/portrait_display/build_phone_page.py
#pragma once
#include <pgmspace.h>
namespace epd36 {
static const char kPhoneIndexHtml[] PROGMEM = R"P36PAGE(<!doctype html>
<html lang="zh-CN">
<head>
<meta charset="utf-8"><meta name="viewport" content="width=device-width,initial-scale=1">
<meta name="referrer" content="no-referrer"><title>Chroma · 手机更新</title>
<style>
:root{color-scheme:light;--ink:#142032;--muted:#586579;--line:#dce2ea;--blue:#2556a8;--paper:#fff;--bg:#f4f6f9}
*{box-sizing:border-box}body{margin:0;background:var(--bg);color:var(--ink);font:15px/1.55 -apple-system,BlinkMacSystemFont,"Segoe UI",sans-serif}button,input,select{font:inherit}button{cursor:pointer}button:disabled{cursor:not-allowed;opacity:.45}header{max-width:1100px;margin:auto;padding:30px 24px 20px;display:flex;justify-content:space-between;gap:12px;align-items:center}.brand{font-weight:800;letter-spacing:.04em;font-size:21px}.tag{color:var(--muted);font-size:12px;border:1px solid var(--line);border-radius:20px;padding:4px 10px}main{max-width:1100px;margin:auto;padding:0 24px 32px;display:grid;grid-template-columns:minmax(270px,1fr) minmax(300px,1fr);gap:24px}.panel{background:var(--paper);border:1px solid var(--line);border-radius:18px;padding:26px}.preview-shell{background:#e8edf3;padding:28px;border-radius:12px;display:grid;place-items:center}canvas{width:min(100%,320px);height:auto;aspect-ratio:2/3;background:#fff;border-radius:2px;box-shadow:0 8px 28px #15253b18;image-rendering:pixelated}.caption{font-size:12px;color:var(--muted);margin:14px 0 0}h1{font-size:26px;line-height:1.3;margin:0 0 8px}h2{font-size:15px;margin:26px 0 10px}p{margin:8px 0}.intro{color:var(--muted);font-size:14px}.field{display:block;margin-top:18px;font-weight:650;font-size:13px}.field input,.field select{display:block;width:100%;margin-top:7px;border:1px solid var(--line);border-radius:9px;padding:10px;background:#fff;color:var(--ink)}input[type=file]{font-size:13px}.row{display:flex;gap:10px}.row>*{flex:1}.button{border:0;border-radius:10px;padding:12px 18px;background:var(--blue);color:#fff;font-weight:700}.secondary{background:#eef2f8;color:var(--ink)}.subtle{font-size:13px;color:var(--muted)}.actions{display:flex;gap:10px;margin-top:20px}.actions .button{flex:1}.status{padding:12px 14px;background:#eff3f8;border-radius:10px;margin-top:18px;font-size:13px;white-space:pre-wrap;overflow-wrap:anywhere}.status.error{background:#fff0ee;color:#92291d}.status.good{background:#eaf5ef;color:#20663f}progress{display:block;width:100%;height:8px;margin-top:16px;accent-color:var(--blue)}.palette{display:flex;gap:6px;margin-top:12px}.palette span{height:16px;width:16px;border-radius:50%;border:1px solid #0002}.mock{display:none;padding:10px 24px;background:#fff0cb;color:#604709;text-align:center;font-size:13px}.token{font-family:monospace;letter-spacing:.03em}details{font-size:12px;color:var(--muted);margin-top:20px}summary{cursor:pointer}.visually-hidden{position:absolute;width:1px;height:1px;overflow:hidden;clip-path:inset(50%)}@media(max-width:720px){header{padding:20px 18px}main{grid-template-columns:1fr;padding:0 16px 24px;gap:16px}.panel{padding:20px}.preview-panel{order:2}.control-panel{order:1}h1{font-size:24px}.preview-shell{padding:20px}canvas{max-width:260px}.tag{font-size:11px}}
</style></head>
<body>
<div id="mock" class="mock">浏览器演练：此页面连接软件模拟器，不连接工牌或无线硬件</div>
<header><div class="brand">CHROMA <span style="font-weight:400">/ 手机更新</span></div><span class="tag">P1 · 本地诊断</span></header>
<main>
<section class="panel preview-panel" aria-label="六色显示预览"><div class="preview-shell"><canvas id="preview" width="400" height="600" aria-label="400乘600六色图片预览"></canvas></div><div class="palette" aria-label="黑白黄红蓝绿六色"><span style="background:#141820"></span><span style="background:#fff"></span><span style="background:#f4c926"></span><span style="background:#c6232d"></span><span style="background:#1f4ea4"></span><span style="background:#1c7d4b"></span></div><p class="caption">400 × 600 · 六色 · 120 KB<br>这是软件排版预览，实屏色彩与刷新效果需实测</p></section>
<section class="panel control-panel"><h1>把图片放到工牌上</h1><p class="intro">图片在手机浏览器中转换，再通过工牌热点发送。无需家庭 Wi-Fi 密码，不上传云端。</p>
<label class="field">1 · 选择 PNG / JPEG 图片<input id="file" type="file" accept="image/png,image/jpeg"></label>
<div class="row"><label class="field">画面适配<select id="fit"><option value="contain">完整显示，留白</option><option value="cover">填满画面，居中裁切</option></select></label><label class="field">转换方式<select id="mode"><option value="text">文字清晰</option><option value="photo">照片细节（抖色）</option></select></label></div>
<p id="file-info" class="subtle">建议使用竖版图片，姓名与二维码保持黑白高对比</p>
<label class="field">2 · 临时连接码<input id="token" class="token" type="password" maxlength="32" autocomplete="off" spellcheck="false" placeholder="输入屏上两行拼接后的32位连接码"></label>
<p class="subtle">长按 UPDATE 键 2 秒进入配网。屏上连接码分两行，请拼接输入且不带空格；本版本不生成配网二维码。热点限时有效，显示配网信息会替换当前画面。</p>
<div class="actions"><button id="connect" class="button secondary">检查连接</button><button id="download" class="button secondary" disabled>下载 USB 文件</button></div>
<div class="actions"><button id="send" class="button" disabled>发送并刷新工牌</button><button id="cancel" class="button secondary" hidden>取消上传</button></div>
<progress id="progress" max="120000" value="0" hidden></progress><div id="status" class="status" role="status" aria-live="polite">先选择图片，再检查工牌连接</div>
<details><summary>更新与安全说明</summary><p>只有整帧的长度、六色色码和 CRC 都通过校验后，显式刷新请求才会启动屏幕。上传中断不会启动新刷新；刷新一旦开始就无法安全取消。</p><p>这是单缓冲诊断程序，不保存上一帧 RAM 或 Flash 历史。重启后需重新上传。若刷新超时或掉电，屏面状态可能不完整，请检查工牌后重试。</p><p>此页面没有门禁卡、NFC凭证或第三方账号功能。请在匹配的新屏硬件上验证供电后使用。</p></details>
</section></main>
<script>
/* SPDX-License-Identifier: MIT */
(function (root) {
  "use strict";
  const width = 400, height = 600;
  // Preview RGB values are illustrative; native controller nibble codes are exact.
  const palette = [
    {code: 0, rgb: [20, 24, 32]}, {code: 1, rgb: [255, 255, 255]},
    {code: 2, rgb: [244, 201, 38]}, {code: 3, rgb: [198, 35, 45]},
    {code: 5, rgb: [31, 78, 164]}, {code: 6, rgb: [28, 125, 75]}
  ];
  const linear = Array.from({length: 256}, (_, x) => {
    const n = x / 255;
    return n <= 0.04045 ? n / 12.92 : Math.pow((n + 0.055) / 1.055, 2.4);
  });
  const linearPalette = palette.map(p => p.rgb.map(x => linear[x]));
  const clamp = x => Math.max(0, Math.min(255, Math.round(x)));
  function inspectImage(bytes, mime = "") {
    // Reject SVG/HTML and unsupported containers BEFORE creating a blob URL or
    // invoking the browser decoder. Validate declared raster dimensions first.
    if (!bytes || bytes.length > 20 * 1024 * 1024) throw new Error("图片超过20 MB，请先缩小再选择");
    let w = 0, h = 0, format = "";
    if (bytes.length >= 24 && [137,80,78,71,13,10,26,10].every((v, i) => bytes[i] === v) &&
        bytes[12] === 73 && bytes[13] === 72 && bytes[14] === 68 && bytes[15] === 82) {
      const view = new DataView(bytes.buffer, bytes.byteOffset, bytes.byteLength);
      w = view.getUint32(16); h = view.getUint32(20); format = "image/png";
    } else if (bytes.length >= 4 && bytes[0] === 255 && bytes[1] === 216) {
      let p = 2;
      while (p < bytes.length) {
        if (bytes[p++] !== 255) break;
        while (p < bytes.length && bytes[p] === 255) p++;
        if (p >= bytes.length) break;
        const marker = bytes[p++];
        if (marker === 0xd9 || marker === 0xda) break;
        if (marker === 0x01 || marker >= 0xd0 && marker <= 0xd8) continue;
        if (p + 2 > bytes.length) break;
        const size = (bytes[p] << 8) | bytes[p + 1];
        if (size < 2 || p + size > bytes.length) break;
        if ([0xc0,0xc1,0xc2,0xc3,0xc5,0xc6,0xc7,0xc9,0xca,0xcb,0xcd,0xce,0xcf].includes(marker)) {
          if (size < 7) break;
          h = (bytes[p + 3] << 8) | bytes[p + 4];
          w = (bytes[p + 5] << 8) | bytes[p + 6]; format = "image/jpeg"; break;
        }
        p += size;
      }
    }
    if (!format || mime && mime !== format) throw new Error("仅支持有效 PNG 或 JPEG，不接受 SVG、HTML 或其他文件");
    if (!w || !h || w > 16384 || h > 16384 || w * h > 20000000) throw new Error("图片尺寸过大或无效，请缩小到2000万像素以内");
    return {width: w, height: h, format};
  }
  function crc32(bytes) {
    let crc = 0xffffffff;
    for (const byte of bytes) {
      crc ^= byte;
      for (let bit = 0; bit < 8; bit++) crc = (crc >>> 1) ^ ((crc & 1) ? 0xedb88320 : 0);
    }
    return ((crc ^ 0xffffffff) >>> 0).toString(16).padStart(8, "0");
  }
  function quantize(rgba, w = width, h = height, dither = false) {
    if (!Number.isInteger(w) || !Number.isInteger(h) || w <= 0 || h <= 0 ||
        w * h > 400 * 600 || rgba.length !== w * h * 4) throw new Error("无效图片尺寸");
    const work = new Float32Array(w * h * 3);
    for (let p = 0; p < w * h; p++) {
      const alpha = rgba[p * 4 + 3] / 255;
      for (let c = 0; c < 3; c++) work[p * 3 + c] = rgba[p * 4 + c] * alpha + 255 * (1 - alpha);
    }
    const bytes = new Uint8Array(Math.ceil(w * h / 2));
    const preview = new Uint8ClampedArray(w * h * 4);
    for (let y = 0; y < h; y++) for (let x = 0; x < w; x++) {
      const p = y * w + x;
      const rgb = [clamp(work[p * 3]), clamp(work[p * 3 + 1]), clamp(work[p * 3 + 2])];
      const sample = rgb.map(c => linear[c]);
      let best = 0, distance = Infinity;
      for (let i = 0; i < palette.length; i++) {
        const candidate = linearPalette[i];
        const d = 0.2126 * (sample[0] - candidate[0]) ** 2 +
          0.7152 * (sample[1] - candidate[1]) ** 2 + 0.0722 * (sample[2] - candidate[2]) ** 2;
        if (d < distance) { distance = d; best = i; }
      }
      const color = palette[best];
      bytes[p >>> 1] |= color.code << ((p & 1) ? 0 : 4);
      for (let c = 0; c < 3; c++) preview[p * 4 + c] = color.rgb[c];
      preview[p * 4 + 3] = 255;
      if (dither) {
        for (const [dx, dy, weight] of [[1, 0, 7/16], [-1, 1, 3/16], [0, 1, 5/16], [1, 1, 1/16]]) {
          if (x + dx < 0 || x + dx >= w || y + dy >= h) continue;
          const q = ((y + dy) * w + x + dx) * 3;
          for (let c = 0; c < 3; c++) work[q + c] += (rgb[c] - color.rgb[c]) * weight;
        }
      }
    }
    return {bytes, preview, crc: crc32(bytes)};
  }
  const api = {width, height, palette, crc32, quantize, inspectImage};
  if (typeof module !== "undefined" && module.exports) module.exports = api;
  root.PhoneCore = api;
})(typeof globalThis !== "undefined" ? globalThis : this);

</script><script>
/* SPDX-License-Identifier: MIT */
(function () {
  "use strict";
  const $ = id => document.getElementById(id);
  const canvas = $("preview"), context = canvas.getContext("2d", {willReadFrequently: true});
  let picture = null, frame = null, connected = false, busy = false, cancelled = false, startedDisplay = false;
  let pictureVersion = 0;
  const hash = new URLSearchParams(location.hash.slice(1));
  if (/^[0-9a-f]{32}$/i.test(hash.get("token") || "")) $("token").value = hash.get("token");
  if (location.hash) history.replaceState(null, "", location.pathname + location.search);
  context.fillStyle = "#fff"; context.fillRect(0, 0, 400, 600);
  context.fillStyle = "#536176"; context.font = "20px sans-serif"; context.textAlign = "center";
  context.fillText("图片预览", 200, 290); context.font = "13px sans-serif"; context.fillText("400 × 600", 200, 320);
  function status(message, kind = "") { $("status").textContent = message; $("status").className = "status " + kind; }
  function updateControls() {
    $("send").disabled = busy || !frame || !connected;
    $("download").disabled = busy || !frame;
    for (const id of ["file", "fit", "mode", "connect", "token"]) $(id).disabled = busy;
    $("cancel").hidden = !busy || startedDisplay;
  }
  function token() {
    const value = $("token").value.trim();
    if (!/^[a-f0-9]{32}$/i.test(value)) throw new Error("请输入屏上两行拼接后的32位临时连接码，或使用串口输出的完整链接");
    return value;
  }
  async function request(path, {method = "GET", body, timeout = 6000} = {}) {
    const controller = new AbortController(), timer = setTimeout(() => controller.abort(), timeout);
    const headers = {"X-P36-Token": token()};
    if (body && !(body instanceof Uint8Array)) { headers["Content-Type"] = "application/json"; body = JSON.stringify(body); }
    else if (body) headers["Content-Type"] = "application/octet-stream";
    try {
      const response = await fetch(path, {method, body, headers, signal: controller.signal, cache: "no-store", credentials: "omit"});
      const text = await response.text();
      let data;
      try { data = JSON.parse(text); } catch (_) { throw new Error("工牌返回了无法识别的响应"); }
      if (!response.ok) {
        if (response.status === 401 || response.status === 403) throw new Error("连接码错误或已过期，请重新配网");
        if (response.status === 409) throw new Error("工牌正被另一个更新会话使用，请等其结束");
        throw new Error(data.error || data.status || "工牌拒绝请求");
      }
      if (data.mock) $("mock").style.display = "block";
      return data;
    } catch (error) {
      if (error.name === "AbortError") throw new Error("工牌响应超时，请确认仍连接工牌热点");
      if (error instanceof TypeError) throw new Error("无法连接工牌，请确认手机连接的是工牌热点");
      throw error;
    } finally { clearTimeout(timer); }
  }
  function render() {
    if (!picture) return;
    frame = null; updateControls();
    const stage = document.createElement("canvas"); stage.width = 400; stage.height = 600;
    const c = stage.getContext("2d", {willReadFrequently: true});
    c.fillStyle = "#fff"; c.fillRect(0, 0, 400, 600);
    const factor = $("fit").value === "cover" ? Math.max(400 / picture.width, 600 / picture.height) : Math.min(400 / picture.width, 600 / picture.height);
    const w = picture.width * factor, h = picture.height * factor;
    c.drawImage(picture, (400 - w) / 2, (600 - h) / 2, w, h);
    frame = PhoneCore.quantize(c.getImageData(0, 0, 400, 600).data, 400, 600, $("mode").value === "photo");
    context.putImageData(new ImageData(frame.preview, 400, 600), 0, 0);
    $("file-info").textContent = `已转换为六色 · 120,000 字节 · CRC ${frame.crc}`;
    status("预览已准备好。确认画面后连接工牌并发送"); updateControls();
  }
  $("file").addEventListener("change", async () => {
    const version = ++pictureVersion, file = $("file").files[0];
    if (!file) return;
    picture = null; frame = null; updateControls();
    if (file.size > 20 * 1024 * 1024) { status("图片超过20 MB，请先缩小再选择", "error"); return; }
    let url = null;
    try {
      status("正在手机浏览器中检查并转换图片…");
      if (file.type && !["image/png", "image/jpeg"].includes(file.type)) throw new Error("仅支持 PNG 或 JPEG，不接受 SVG 或其他文件");
      const raster = new Uint8Array(await file.arrayBuffer());
      PhoneCore.inspectImage(raster, file.type);
      if (version !== pictureVersion) return;
      url = URL.createObjectURL(file);
      const image = new Image();
      await new Promise((resolve, reject) => { image.onload = resolve; image.onerror = () => reject(new Error("无法读取这张图片，请换成 PNG 或 JPEG")); image.src = url; });
      if (version !== pictureVersion) return;
      if (image.width * image.height > 20000000) throw new Error("图片像素过大，请缩小到2000万像素以内");
      picture = image; render();
    } catch (error) { if (version === pictureVersion) { picture = frame = null; status(error.message, "error"); updateControls(); } }
    finally { if (url) URL.revokeObjectURL(url); }
  });
  $("fit").addEventListener("change", render); $("mode").addEventListener("change", render);
  $("token").addEventListener("input", () => { connected = false; updateControls(); });
  $("connect").addEventListener("click", async () => {
    busy = true; startedDisplay = true; updateControls();
    try { await request("/api/status"); connected = true; status("已连接工牌。确认预览后点击发送并刷新", "good"); }
    catch (error) { connected = false; status(error.message, "error"); }
    finally { busy = false; startedDisplay = false; updateControls(); }
  });
  $("download").addEventListener("click", () => {
    if (!frame || busy) return;
    const url = URL.createObjectURL(new Blob([frame.bytes], {type: "application/octet-stream"}));
    const link = document.createElement("a"); link.href = url; link.download = "badge-400x600-native.bin"; link.click();
    setTimeout(() => URL.revokeObjectURL(url), 1000);
    status("已生成 USB 原生帧文件，可用 send_frame.py 发送");
  });
  $("cancel").addEventListener("click", () => { if (!startedDisplay) { cancelled = true; status("正在停止上传；不会发送刷新命令…"); } });
  $("send").addEventListener("click", async () => {
    if (busy || !frame || !connected) return;
    busy = true; cancelled = false; startedDisplay = false; updateControls();
    $("progress").hidden = false; $("progress").value = 0;
    const current = frame;
    let confirmedNotStarted = false;
    try {
      await request("/api/reset", {method: "POST"});
      if (cancelled) throw new Error("上传已取消，未发送刷新命令");
      await request("/api/begin", {method: "POST", body: {size: current.bytes.length, crc: current.crc}});
      for (let offset = 0; offset < current.bytes.length; offset += 4096) {
        if (cancelled) throw new Error("上传已取消，未发送刷新命令");
        const chunk = current.bytes.subarray(offset, Math.min(offset + 4096, current.bytes.length));
        await request(`/api/chunk?offset=${offset}`, {method: "POST", body: chunk});
        $("progress").value = offset + chunk.length;
        status(`正在上传 ${Math.round(100 * (offset + chunk.length) / current.bytes.length)}% · 尚未刷新屏幕`);
      }
      if (cancelled) throw new Error("上传已取消，未发送刷新命令");
      startedDisplay = true; updateControls();
      status("整帧已发送，正在请求刷新。刷新开始后请保持供电，不要重新发送…");
      const accepted = await request("/api/show", {method: "POST", body: {crc: current.crc}});
      const job = accepted.job;
      if (!Number.isInteger(job)) throw new Error("工牌未返回有效刷新任务号");
      const deadline = Date.now() + 90000;
      let lastError = "";
      while (Date.now() < deadline) {
        await new Promise(resolve => setTimeout(resolve, 1800));
        let result;
        try { result = await request("/api/status", {timeout: 3500}); }
        catch (error) { lastError = error.message; status("工牌正在刷新，暂时无法响应。请保持供电并等待…"); continue; }
        const phase = result.display_status || result.display || "";
        if (phase === "done" || phase === "ok" || phase === "Ok") {
          if (result.job !== job || result.result !== "Ok") throw new Error("刷新任务号或完成状态不一致");
          if (result.crc && result.crc.toLowerCase() !== current.crc) throw new Error("工牌报告的帧校验值不一致");
          status(result.mock ? "模拟器已完成完整上传与刷新流程；未连接真实屏幕" : "工牌报告刷新完成。请查看实屏确认画面", "good");
          return;
        }
        if (phase === "failed" || phase === "error") {
          if (result.driver_result === "PowerUnsafe") {
            confirmedNotStarted = true;
            throw new Error("供电不足，请先连接USB供电或充电");
          }
          throw new Error(`工牌刷新失败：${result.driver_result || result.result || result.error || "未知错误"}`);
        }
        status("工牌正在刷新。屏幕闪动属于刷新过程，请保持供电…");
      }
      throw new Error("等待刷新结果超时" + (lastError ? `；${lastError}` : ""));
    } catch (error) {
      if (!startedDisplay || confirmedNotStarted) { try { await request("/api/reset", {method: "POST", timeout: 2000}); } catch (_) {} }
      status(error.message + (confirmedNotStarted ? "。未启动刷新，本次请求没有改变屏幕画面" : startedDisplay ? "。刷新可能已经开始，屏面状态未知；请检查工牌，再查询连接状态" : "。没有请求新刷新"), "error");
    } finally { busy = false; startedDisplay = false; $("progress").hidden = true; updateControls(); }
  });
})();

</script>
</body></html>
)P36PAGE";
}
